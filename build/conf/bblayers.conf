## build/meta-bsp/recipes-bsp/zephyr/files/its/virt64.its
```
/*
 * Copyright (c) 2026 EDGEMTech SA
 *
 * Bare Zephyr ITS for QEMU virt64 — the Zephyr counterpart of
 * recipes-bsp/linux/files/its/virt64.its. Pairs with IB_BOOT_CHAIN=
 * "uboot": QEMU loads the U-Boot ELF directly, U-Boot bootm's this ITB,
 * and Zephyr runs on the bare metal. No ATF, no OP-TEE, no AVZ.
 *
 * Template: ${IB_*} placeholders are expanded to absolute build paths by
 * bsp_render_its (bsp.bbclass) at do_render_its time.
 *
 * Two things this file exists to record, both learned against the tree's
 * own U-Boot 2022.04:
 *
 *  1. The `compatible` in the configuration node is load-bearing. This
 *     U-Boot is built with CONFIG_FIT_BEST_MATCH, so boot_get_kernel()
 *     (boot/image-fit.c) resolves a bare `bootm <addr>` through
 *     fit_conf_find_compat() against the control FDT — the `default`
 *     property is not consulted on that path. Without a matching
 *     compatible the boot dies with "Could not find configuration node".
 *     "linux,dummy-virt" is what QEMU's virt machine reports.
 *
 *  2. The FDT image is required even though Zephyr never reads it. See
 *     virt64_fdt.dts for why, and why it is a local blob rather than the
 *     Linux build's.
 *
 * Load addresses follow the existing virt64 map: Zephyr at 0x41000000,
 * matching CONFIG_SRAM_BASE_ADDRESS of the ib_virt64 board, and the
 * FDT at 0x50000000.
 */

/dts-v1/;

/ {
	description = "Zephyr RTOS for virt64 (armv8) environment";

	images {

		zephyr {
			description = "Zephyr RTOS";
			data = /incbin/("${IB_ZEPHYR_IMAGE}");
			type = "kernel";
			arch = "arm64";
			os = "linux";
			compression = "none";
			load = <0x41000000>;
			entry = <0x41000000>;
		};

		fdt_zephyr {
			description = "Minimal device tree (U-Boot requirement)";
			data = /incbin/("${IB_ZEPHYR_FDT}");
			type = "flat_dt";
			arch = "arm64";
			compression = "none";
			load = <0x50000000>;
		};
	};

	configurations {
		default = "conf_zephyr";

		conf_zephyr {
			description = "Zephyr on virt64";
			compatible = "linux,dummy-virt";
			kernel = "zephyr";
			fdt = "fdt_zephyr";
		};
	};
};
```

## build/meta-bsp/recipes-bsp/zephyr/files/its/virt64_mcuboot_guest.its
```
/*
 * Copyright (C) 2026 EDGEMTech SA <info@edgemtech.ch>
 *
 * MCUboot as an AVZ guest, for the boot target that asks for a bootloader.
 * This is the shape a product tree with a hypervisor normally runs.
 *
 * A GUEST bundle, the same shape as virt64_zephyr_guest.its, and loaded the
 * same way — U-Boot's guest-boot command takes the AVZ ITB and this one. The
 * point of the exercise is that the developer's chain is the product's:
 * ATF, OP-TEE, U-Boot, AVZ, then the bootloader, then the application. A
 * bootloader entered by plain bootm would run somewhere the hardware never
 * runs it.
 *
 * 0x41000000 is not a free choice: AVZ enters the guest at the IPA its FDT
 * declares, whatever address the ITB loaded it at, so the first image in the
 * domain must be linked there. The application MCUboot RAM-loads goes to
 * 0x48000000 instead. See conf/ib_virt64-payload.overlay.
 *
 * Template: ${IB_*} placeholders are expanded to absolute build paths by
 * bsp_render_its (bsp.bbclass) at do_render_its time.
 *
 * This program is free software; you can redistribute it and/or modify
 * it under the terms of the GNU General Public License version 2 as
 * published by the Free Software Foundation.
 */

/dts-v1/;

/ {
	description = "MCUboot guest bundle for virt64 (armv8)";

	images {

		zephyr {
			description = "MCUboot (guest)";
			data = /incbin/("${IB_ZEPHYR_BOOT_IMAGE}");
			type = "guest";
			arch = "arm64";
			os = "linux";
			compression = "none";
			load = <0x41000000>;
			entry = <0x41000000>;
		};

		fdt {
			description = "Guest device tree (AVZ-exposed)";
			data = /incbin/("${IB_ZEPHYR_FDT}");
			type = "flat_dt";
			arch = "arm64";
			compression = "none";
			load = <0x50000000>;
		};
	};

	configurations {
		default = "capsule";

		capsule {
			description = "MCUboot guest on virt64";
			loadables = "zephyr";
			fdt = "fdt";
		};
	};
};
```

## build/meta-zephyr/recipes-zephyr/flash-disk/dts/bindings/flash/edgemtech,flash-disk.yaml
```yaml
# Copyright (c) 2026 EDGEMTech SA
# SPDX-License-Identifier: Apache-2.0

description: |
  A flash device backed by a window of a block device.

  reg gives the byte offset and size of the window within the disk, so two
  nodes can carve independent slots out of one device. Children are the
  usual fixed-partitions.

compatible: "edgemtech,flash-disk"

include: [base.yaml]

properties:
  reg:
    required: true

  disk-name:
    type: string
    required: true
    description: |
      Name the block device registered with the disk access layer, as in
      the disk-name property of the virtio,blk or sdmmc node backing it.

  erase-block-size:
    type: int
    required: true
    description: |
      Erase granularity presented to the flash API. A disk has no erase, so
      this only sets the page size callers must align to; the driver honours
      it by writing erase-value over the range.

  write-block-size:
    type: int
    required: true

  erase-value:
    type: int
    default: 255
```

## build/meta-zephyr/recipes-zephyr/zephyr/files/boards/edgemtech/ib_virt64/Kconfig.defconfig
```kconfig
# Copyright (c) 2026 EDGEMTech SA
# SPDX-License-Identifier: Apache-2.0

if BOARD_EDGEM1_VIRT64

config BUILD_OUTPUT_BIN
	default y

config MAX_THREAD_BYTES
	default 3

endif # BOARD_EDGEM1_VIRT64
```

## build/meta-zephyr/recipes-zephyr/zephyr/files/boards/edgemtech/ib_virt64/Kconfig.ib_virt64
```kconfig
# Copyright (c) 2026 EDGEMTech SA
# SPDX-License-Identifier: Apache-2.0

config BOARD_EDGEM1_VIRT64
	select SOC_QEMU_CORTEX_A53
```

## build/meta-zephyr/recipes-zephyr/zephyr/files/boards/edgemtech/ib_virt64/board.yml
```yaml
board:
  name: ib_virt64
  full_name: EDGE-M1 virt64 (QEMU aarch64 virt, GICv2)
  vendor: qemu
  socs:
    - name: qemu_cortex_a53
```
